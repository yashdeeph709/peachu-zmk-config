## config/boards/shields/Kconfig.sheild
```kconfig
config SHIELD_PEACHU_LEFT
    def_bool $(shields_list_contains,peachu_left)

config SHIELD_PEACHU_RIGHT
    def_bool $(shields_list_contains,peachu_right)
```
